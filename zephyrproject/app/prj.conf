## CMakeLists.txt
```
cmake_minimum_required(VERSION 3.20.0)

# Zoek Zephyr in de workspace
find_package(Zephyr REQUIRED HINTS $ENV{ZEPHYR_BASE})
project(led_clock)

# Voeg jouw source bestanden toe
target_sources(app PRIVATE src/main.c)
```

## prj.conf
```kconfig
# Basis Zephyr configuratie voor de LED Clock
CONFIG_CONSOLE=y
CONFIG_PRINTK=y
CONFIG_STDOUT_CONSOLE=y

# Networking
CONFIG_NETWORKING=y
CONFIG_NET_IPV4=y
CONFIG_NET_DHCPV4=y
CONFIG_NET_SOCKETS=y

# mDNS / DNS-SD
#CONFIG_MDNS_RESOLVER=y
#CONFIG_MDNS_RESPONDER=y

# ESP32 Wi-Fi
CONFIG_WIFI=y
CONFIG_NET_L2_WIFI_MGMT=y

# Future: API server (HTTP)
#CONFIG_NET_HTTP_SERVER=y
```

## src/main.c
```c
#include <zephyr/kernel.h>
#include <zephyr/sys/printk.h>
#include <zephyr/net/net_if.h>
#include <zephyr/net/mdns_responder.h>

void main(void) {
    printk("🚀 LED Clock firmware started on Zephyr!\n");

    // Hier kun je later Wi-Fi connectie, mDNS en API server toevoegen
    // Voor nu alleen een hello world
    while (1) {
        printk("LED Clock running...\n");
        k_sleep(K_SECONDS(5));
    }
}
```
